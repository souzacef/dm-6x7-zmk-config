  /*   * Copyright (c) 2020 The ZMK Contributors
 *
 * SPDX-License-Identifier: MIT
 */

#include "dactyl_manuform_6x7.dtsi"

&kscan0 {
	col-gpios = 
	    <&gpio0 2 GPIO_ACTIVE_HIGH>,
        <&gpio0 9 GPIO_ACTIVE_HIGH>,
        <&gpio0 10 GPIO_ACTIVE_HIGH>,
        <&gpio0 29 GPIO_ACTIVE_HIGH>,
        <&gpio0 31 GPIO_ACTIVE_HIGH>,
        <&gpio0 113 GPIO_ACTIVE_HIGH>;
};
